## config/boards/shields/optimag/Kconfig.defconfig
```kconfig
# Copyright (c) 2020 The ZMK Contributors
# SPDX-License-Identifier: MIT

if SHIELD_OPTIMAG_LEFT

config ZMK_KEYBOARD_NAME
    default "optimag"

config ZMK_SPLIT_ROLE_CENTRAL
    default y

endif

if SHIELD_OPTIMAG_LEFT || SHIELD_OPTIMAG_RIGHT

config ZMK_SPLIT
    default y

endif
```

## config/boards/shields/optimag/Kconfig.shield
```kconfig
# Copyright (c) 2020 The ZMK Contributors
# SPDX-License-Identifier: MIT

config SHIELD_OPTIMAG_LEFT
    def_bool $(shields_list_contains,optimag_left)

config SHIELD_OPTIMAG_RIGHT
    def_bool $(shields_list_contains,optimag_right)
```
